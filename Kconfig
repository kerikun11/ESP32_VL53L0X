## Kconfig
```kconfig
menu "vl53l0x specific"
  config I2C_ADDRESS
      hex "I2C address of the VL53L0X"
      default 0x29


  choice I2C_PORT
      prompt "I2C port"
      default I2C_PORT_NUM0
      config I2C_PORT_NUM0
          bool "I2C_NUM0"
      config I2C_PORT_NUM1
          bool "I2C_NUM1"
  endchoice

  config I2C_SDA_GPIO
      int "SDA on GPIO#"
      range 0 33
      default 21

  config I2C_SCL_GPIO
      int "SCL on GPIO#"
      range 0 33
      default 22

  config XSHUT_ENABLE
      bool "Enable XSHUT"
      default false

  config XSHUT_GPIO
      int "XSHUT on GPIO#"
      depends on XSHUT_ENABLE
      range 0 33
      default 23

  config INT_ENABLE
      bool "Enable INT"
      default false

  config INT_GPIO
      int "INT on GPIO#"
      depends on INT_ENABLE
      range 0 33
      default 24

endmenu
```

## example/sdkconfig.defaults
```kconfig
#
# Espressif IoT Development Framework Configuration
#

#
# Serial flasher config
#
CONFIG_ESPTOOLPY_BAUD_2MB=y
CONFIG_FLASHMODE_QIO=y
CONFIG_ESPTOOLPY_FLASHFREQ_80M=y
CONFIG_ESPTOOLPY_FLASHSIZE_4MB=y

#
# Compiler options
#
CONFIG_CXX_EXCEPTIONS=y

#
# Component config
#

#
# ESP32-specific
#
CONFIG_ESP32_DEFAULT_CPU_FREQ_240=y
CONFIG_CONSOLE_UART_BAUDRATE=115200

#
# FAT Filesystem support
#
CONFIG_FATFS_LFN_HEAP=y

#
# FreeRTOS
#
CONFIG_FREERTOS_HZ=1000
CONFIG_FREERTOS_ASSERT_FAIL_PRINT_CONTINUE=y
```
